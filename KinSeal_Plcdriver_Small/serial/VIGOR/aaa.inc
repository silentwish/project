 驱动器 D 中的卷是 新加卷
 卷的序列号是 32AC-75D1

 D:\KinSeal_PC\KinSealStudio-build-desktop\debug\Link\serial\VIGOR 的目录

2015/08/05  19:48    <DIR>          .
2015/08/05  19:48    <DIR>          ..
2010/06/02  14:13                19 dir.BAT
2015/08/05  19:48                 0 aaa.inc
2015/05/20  13:45               753 Vigor_M.ini
2015/05/20  13:54               756 Vigor_VB.ini
2015/05/20  13:54               752 Vigor_VH.ini
2015/05/20  13:55               755 Vigor_VS.ini
2012/05/30  14:17             9,096 Vigor.ks1
2015/01/28  16:34            12,528 Vigor_VS.ks1
2012/05/30  14:17             9,096 Vigor.ks2
2015/01/28  16:39            12,524 Vigor_VS.ks2
              10 个文件         46,279 字节
               2 个目录 219,435,802,624 可用字节
