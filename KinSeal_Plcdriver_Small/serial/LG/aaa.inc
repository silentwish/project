 驱动器 D 中的卷是 新加卷
 卷的序列号是 32AC-75D1

 D:\KinSeal_PC\KinSealStudio-build-desktop\debug\Link\serial\LG 的目录

2015/08/05  19:54    <DIR>          .
2015/08/05  19:54    <DIR>          ..
2010/06/02  14:13                19 dir.BAT
2015/08/05  19:54                 0 aaa.inc
2015/05/20  10:23               720 LG_K10S.ini
2015/05/20  10:21               726 LG_K10S1.ini
2015/05/20  10:24               721 LG_K120S.ini
2015/05/20  10:24               721 LG_K200S.ini
2015/05/20  10:27               727 LG_K300S.ini
2015/05/20  10:26               722 LG_K30S.ini
2015/05/20  10:26               720 LG_K60S.ini
2015/05/20  10:26               720 LG_K80S.ini
2015/05/20  10:31               762 LG_XGB_CNET.ini
2014/12/02  08:36            12,472 LG.ks1
2012/05/30  14:17             8,828 LG_K10S1.ks1
2012/05/30  14:17             8,664 LG_K300S.ks1
2013/05/23  17:52            12,108 LG_XGB_CNET.ks1
2012/05/30  14:17             8,828 LG_K10S1.ks2
2012/05/30  14:17             8,664 LG_K300S.ks2
2013/05/23  17:52            12,108 LG_XGB_CNET.ks2
              18 个文件         78,230 字节
               2 个目录 219,435,778,048 可用字节
