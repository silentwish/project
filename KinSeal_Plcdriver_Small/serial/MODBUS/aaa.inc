 驱动器 D 中的卷是 新加卷
 卷的序列号是 32AC-75D1

 D:\KinSeal_PC\KinSealStudio-build-desktop\debug\Link\serial\MODBUS 的目录

2015/08/05  19:36    <DIR>          .
2015/08/05  19:36    <DIR>          ..
2010/06/02  14:13                19 dir.BAT
2015/08/05  19:36                 0 aaa.inc
2015/05/20  09:20               773 Modbus_ASCII.ini
2015/05/20  09:20               726 Modbus_ASCII_Slaver.ini
2015/05/20  09:19               769 Modbus_RTU.ini
2015/05/20  09:19               722 Modbus_RTU_Slaver.ini
2012/05/30  14:17            12,576 Modbus_ASCII.ks1
2012/05/30  14:17             5,484 Modbus_ASCII_Slaver.ks1
2015/08/03  16:50            10,752 Modbus_RTU.ks1
2012/05/30  14:17             4,128 Modbus_Slaver.ks1
2012/05/30  14:17            12,576 Modbus_ASCII.ks2
2012/05/30  14:17             5,484 Modbus_ASCII_Slaver.ks2
2012/05/30  14:17            10,368 Modbus_RTU.ks2
2012/05/30  14:17             4,128 Modbus_RTU_Slaver.ks2
              14 个文件         68,505 字节
               2 个目录 219,433,717,760 可用字节
