 驱动器 D 中的卷是 新加卷
 卷的序列号是 32AC-75D1

 D:\KinSeal_PC\KinSealStudio-build-desktop\debug\Link\serial\KEYENCE 的目录

2015/08/05  19:53    <DIR>          .
2015/08/05  19:53    <DIR>          ..
2010/06/02  14:13                19 dir.BAT
2015/08/05  19:53                 0 aaa.inc
2015/05/20  10:16               733 KV.ini
2015/05/20  10:11               786 KV1000.ini
2015/05/20  10:13               786 KV3000.ini
2012/05/30  14:17            11,592 KV.ks1
2014/12/11  14:21            16,572 KV1000.ks1
2015/01/07  11:38            18,688 KV3000.ks1
2012/05/30  14:17            11,592 KV.ks2
2014/12/19  15:42            18,496 KV1000.ks2
2015/01/07  13:40            18,600 KV3000.ks2
              11 个文件         97,864 字节
               2 个目录 219,435,782,144 可用字节
