 驱动器 D 中的卷是 新加卷
 卷的序列号是 32AC-75D1

 D:\KinSeal_PC\KinSealStudio-build-desktop\debug\Link\serial\OMRON 的目录

2015/08/05  19:48    <DIR>          .
2015/08/05  19:48    <DIR>          ..
2010/06/02  14:13                19 dir.BAT
2015/08/05  19:48                 0 aaa.inc
2015/05/20  11:16               788 OMRON_CP1H.ini
2015/05/20  11:12               780 OMRON_CPM.ini
2013/11/05  08:56            15,328 OMRON_CP1H.ks1
2012/05/30  14:17            14,656 OMRON_CPM.ks1
2013/11/05  08:56            15,328 OMRON_CP1H.ks2
2012/05/30  14:17            14,656 OMRON_CPM.ks2
               8 个文件         61,555 字节
               2 个目录 219,435,806,720 可用字节
