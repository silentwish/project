 驱动器 D 中的卷是 新加卷
 卷的序列号是 32AC-75D1

 D:\KinSeal_PC\KinSealStudio-build-desktop\debug\Link\serial\MITSUBISHI 的目录

2015/08/05  19:42    <DIR>          .
2015/08/05  19:42    <DIR>          ..
2010/06/02  14:13                19 dir.BAT
2015/08/05  19:42                 0 aaa.inc
2015/05/20  10:57               766 Mitsubishi_Fx.ini
2015/05/20  10:57               770 Mitsubishi_Fx2n.ini
2015/05/20  11:01               776 Mitsubishi_Fx3U.ini
2015/05/20  10:54               781 Mitsubishi_FX485BD.ini
2015/05/20  11:05               770 Mitsubishi_Q00J.ini
2015/05/20  11:06               772 Mitsubishi_QC24N.ini
2012/05/30  14:17             8,104 Mitsubishi_Fx.ks1
2014/11/21  10:56             8,340 Mitsubishi_Fx2n.ks1
2014/11/20  16:14             8,984 Mitsubishi_Fx3U.ks1
2015/01/22  17:11            15,736 Mitsubishi_FX485BD.ks1
2014/03/17  17:45            24,904 Mitsubishi_Q00J.ks1
2013/05/23  17:52            13,888 Mitsubishi_QC24N.ks1
2012/05/30  14:17             8,104 Mitsubishi_Fx.ks2
2014/11/21  10:56             8,340 Mitsubishi_Fx2n.ks2
2014/11/20  16:15             8,984 Mitsubishi_Fx3U.ks2
2015/01/22  17:12            15,752 Mitsubishi_FX485BD.ks2
2014/03/17  17:45            25,244 Mitsubishi_Q00J.ks2
2013/05/23  17:52            16,256 Mitsubishi_QC24N.ks2
              20 个文件        167,290 字节
               2 个目录 219,433,709,568 可用字节
