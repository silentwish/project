 驱动器 D 中的卷是 新加卷
 卷的序列号是 32AC-75D1

 D:\KinSeal_PC\KinSealStudio-build-desktop\debug\Link\serial\SIEMENS 的目录

2015/08/05  19:38    <DIR>          .
2015/08/05  19:38    <DIR>          ..
2010/06/02  14:13                19 dir.BAT
2015/08/05  19:38                 0 aaa.inc
2015/05/20  11:27               807 Siemens_S7-200.ini
2015/05/20  11:30               765 Siemens_S7-300_MPI.ini
2014/12/17  14:02            17,580 Siemens_S7-200.ks1
2014/08/22  10:19            30,804 Siemens_S7-300_MPI.ks1
2014/12/17  14:02            17,580 Siemens_S7-200.ks2
2014/08/22  10:19            30,804 Siemens_S7-300_MPI.ks2
               8 个文件         98,359 字节
               2 个目录 219,435,819,008 可用字节
