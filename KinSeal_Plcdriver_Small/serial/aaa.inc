 驱动器 D 中的卷是 新加卷
 卷的序列号是 32AC-75D1

 D:\KinSeal_PC\KinSealStudio-build-desktop\debug\Link\serial 的目录

2015/08/05  19:35    <DIR>          .
2015/08/05  19:35    <DIR>          ..
2015/05/20  14:23    <DIR>          Custom
2015/05/20  14:23    <DIR>          DELTA
2015/05/20  14:23    <DIR>          EMERSON
2015/05/25  11:16    <DIR>          FATEK
2015/05/20  14:23    <DIR>          FUJI
2015/05/20  14:23    <DIR>          Haiwell
2015/05/20  14:23    <DIR>          HOLLYSYS
2015/05/20  14:23    <DIR>          KEYENCE
2015/05/20  14:23    <DIR>          LG
2015/05/20  14:23    <DIR>          MITSUBISHI
2015/05/20  14:23    <DIR>          MODBUS
2015/05/20  14:23    <DIR>          OMRON
2015/05/20  14:23    <DIR>          PANASONIC
2015/05/20  14:23    <DIR>          SIEMENS
2015/05/20  14:23    <DIR>          VIGOR
2015/05/20  14:23    <DIR>          XINJIE
2010/06/02  14:13                19 dir.BAT
2015/08/05  19:35                 0 aaa.inc
2015/05/20  14:22             2,143 serial_driver.ini
               3 个文件          2,162 字节
              18 个目录 219,433,738,240 可用字节
